// SPDX-License-Identifier: GPL-2.0-or-later or MIT

/dts-v1/;
/plugin/;

/ {
    compatible = "i2c-gpio";

    fragment@0 {
        target = <&i2c0>;
        
        __overlay__ {
            #address-cells = <1>;
            #size-cells = <0>;

            ssd1306_i2c: oled@3c {
                compatible = "solomon,ssd1306";
                reg = <0x3c>;
            };
        };
    };
};
