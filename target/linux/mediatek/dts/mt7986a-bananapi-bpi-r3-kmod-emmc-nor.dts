/* SPDX-License-Identifier: (GPL-2.0-only OR MIT) */

/dts-v1/;
/plugin/;

#include "mt7986a-bananapi-bpi-r3-emmc-nor.dts"

/ {
    compatible = "bananapi,bpi-r3-kmod", "bananapi,bpi-r3", "mediatek,mt7986a";
    
    fragment@2 {
        target = <&fan>;
        /**
        * Cell 0 corresponds to not tripped, 1 to active-low, etc.
        * Value 0 = 100% duty cycle, so this is fan always on, not sure why this is inverted from `dtsi` file
        * @see ../files-5.15/arch/arm64/boot/dts/mediatek/mt7986a.dtsi#L665
        * @see ../files-5.15/arch/arm64/boot/dts/mediatek/mt7986a.dtsi#L701
        */
        __overlay__ {
            pwms = <&pwm 0 10000 0>;
            cooling-levels = <0 0 0 0>;
            status = "okay";
        };
    };
	/*
    fragment@3 {
        target = <&i2c0>;
        
        __overlay__ {
            #address-cells = <1>;
            #size-cells = <0>;

            ssd1306_i2c: oled@3c {
                compatible = "solomon,ssd1306";
                reg = <0x3c>;
            };
        };
    };
	*/
};
