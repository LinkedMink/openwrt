/* SPDX-License-Identifier: (GPL-2.0-only OR MIT) */

/dts-v1/;
/plugin/;

/ {
    compatible = "bananapi,bpi-r3-kmod", "bananapi,bpi-r3", "mediatek,mt7986a";
    
    fragment@0 {
        target = <&fan>;
        /**
         * Cell 0 corresponds to not tripped, 1 to active-low, etc.
         * Value 0 = 100% duty cycle, so this is fan always on, not sure why this is inverted from `dtsi` file
         */
        __overlay__ {
            cooling-levels = <0 0 0 0>;
        };
    };

    fragment@1 {
        target = <&i2c0>;
        
        __overlay__ {
            clock-frequency = <400000>;

            #address-cells = <1>;
            #size-cells = <0>;

            ssd1306_i2c: oled@3c {
                compatible = "solomon,ssd1306fb-i2c";
                reg = <0x3c>;
                solomon,width = <128>;
                solomon,height = <64>;
                solomon,page-offset = <0>;
            };
        };
    };
};
